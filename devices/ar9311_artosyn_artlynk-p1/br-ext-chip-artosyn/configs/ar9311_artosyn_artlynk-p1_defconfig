## package/ascent-vendor-firmware/Config.in
```kconfig
config BR2_PACKAGE_ASCENT_VENDOR_FIRMWARE
	bool "ascent-vendor-firmware"
	help
	  Fetches and extracts CADDX's "Ascent H Sky" vendor OTA image
	  exactly once, straight into BINARIES_DIR (output/images/
	  ar8030.img, output/images/sensors/*.bin), for hi3516cv6xx_fpv_
	  caddx-ascent-lite's ar8030 (baseband demo firmware) and waybeam
	  (os02k10 sensor tuning) packages to each copy what they need out
	  of and install themselves -- see extract.py's docstring for the
	  full story, including why only the raw vendor zip/img itself
	  (cache/vendor-images/, shared and surviving builder.sh's
	  `rm -rf openipc`) needs persistent caching, not these extracted
	  artifacts.

	  Not meant to be enabled by hand: hi3516cv6xx_fpv_caddx-ascent-
	  lite's defconfig turns this on directly, and ar8030's/waybeam's
	  own FETCH_DEPENDENCY string options (see those packages'
	  Config.in) name it so Buildroot's scheduler builds it first.
	  Single-device-specific by design, same as this repo's
	  kc110-board-support -- not something another AR8030/waybeam
	  board would select unless it also happens to use this exact
	  vendor image.
```

## package/caddx-pctool/Config.in
```kconfig
config BR2_PACKAGE_CADDX_PCTOOL
	bool "caddx-pctool"
	help
	  pctoold: lets CADDX's Windows PC tool (CADDX_PCTool) flash an
	  Ascent air unit while it runs OpenIPC, the same way it flashes
	  one running the stock firmware.

	  Speaks the stock updater's protocol (decoded from a USB capture,
	  see README.md) on the USB gadget's CDC-ACM port, receives the ASW
	  image into /tmp, checks the md5 the PC tool sent, and hands it to
	  sysupgrade --asw=, which flashes the inactive bank and only then
	  switches the boot bank.

	  Installs /usr/bin/pctoold, /etc/default/pctoold and
	  /usr/sbin/pctool-mode, which switches the USB port into and out of
	  updater mode and is the only thing that starts pctoold (nothing
	  runs at boot). The board provides the USB
	  gadget (/usr/bin/usb-gadget with "mode rndis|pctool", stock ids
	  1D76:0101 in pctool mode), the hook (/usr/sbin/pctool-hook) and
	  its identity (its own /etc/default/pctoold); currently
	  hi3516cv6xx_artosyn_caddx-ascent-lite. See README.md.
```

## package/openipc-bsel/Config.in
```kconfig
config BR2_PACKAGE_OPENIPC_BSEL
	bool "openipc-bsel"
	depends on BR2_arm
	help
	  A/B bank selector for boards whose stock bootloader picks which
	  kernel/rootfs bank to boot next (e.g. CADDX Ascent's "fpvboot" u-boot
	  command) by reading a small "BSEL" magic record out of an MTD
	  partition named "sel". Reimplements that same record format
	  (reverse-engineered from the stock ar_bsel binary) so an OpenIPC
	  image running on either bank can flip which bank boots next, without
	  needing the stock bootloader's own userspace tool or its rootfs.

	  Installs /usr/bin/openipc-bsel, CLI-compatible with the stock tool:
	    openipc-bsel check_flash      read current bank from "sel"
	    openipc-bsel check_cmdline    read fpvbsel=N from /proc/cmdline
	    openipc-bsel set 0|1          switch the next boot to bank 0/1

	  Currently enabled by hi3516cv6xx_fpv_caddx-ascent-lite's defconfig.
	  Not device-specific by construction (it locates the "sel" partition
	  by name rather than hardcoding a device), so any other board using
	  the same BSEL scheme could select it too.
```
