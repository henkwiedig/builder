## devices/hi3516cv6xx_artosyn_caddx-ascent-lite/br-ext-chip-hisilicon/board/hi3516cv6xx/fit-image.its
```
/dts-v1/;

/ {
	description = "Linux Kernel";
	#address-cells = <1>;

	images {
		fdt-1 {
			description = "dtb";
			data = /incbin/("fdt.dtb");
			type = "flat_dt";
			arch = "arm";
			compression = "none";
			/*
			 * Not 0x40000000, where firmware's and CADDX's FITs put it:
			 * the kernel builds its first page table at 0x40004000, so
			 * a DTB that U-Boot's fixups grow past 16 KiB loses the
			 * tail of its strings block, and with it property names
			 * (the in-tree demb DTS crossed that in OpenIPC/linux #101
			 * and the USB controller lost "phys"). fdt_high=0xffffffff
			 * boots it where it is loaded. Clear of the kernel and the
			 * relocated decompressor below (~0x40a00000) and of the
			 * 4 MiB fpvboot reads the FIT into at 0x41000000.
			 */
			load = <0x40f00000>;
		};

		linux_kernel {
			description = "Linux";
			data = /incbin/("zImage");
			type = "kernel";
			arch = "arm";
			os = "Linux";
			compression = "none";
			load = <0x40018000>;
			entry = <0x40018000>;
		};
	};

	configurations {
		default = "config-1";
		config-1 {
			description = "Linux";
			kernel = "linux_kernel";
			fdt = "fdt-1";
			loadables = "linux_kernel", "fdt-1";
		};
	};
};
```

## package/ar8030-transport-tx/Config.in
```kconfig
config BR2_PACKAGE_AR8030_TRANSPORT_TX
	bool "ar8030-transport-tx"
	depends on BR2_PACKAGE_AR8030
	depends on BR2_TOOLCHAIN_HAS_THREADS
	depends on BR2_LINUX_KERNEL
	help
	  Air-side bridge between waybeam's frame-shm:// ring and the
	  AR8030's non-IP baseband data channel (bb_socket) -- see
	  https://github.com/henkwiedig/ar8030-transport.

	  Splits each encoded H.265 access unit from waybeam into chunks
	  and writes them to a bb_socket, and throttles waybeam's live
	  bitrate (GET /api/v1/set?video0.bitrate=) from the AR8030's own
	  local TX MCS/throughput reading, so the encoder does not outrun
	  the radio.

	  Also builds and installs this project's own clean-room-rewritten
	  AR8030 SDIO chardev kernel module (kmod/artosyn_drv.c -- see the
	  README's "Clean-room rewrite" section) and this package's own
	  S65 init script loads it, starts ar8030d against it (-i 1, SDIO
	  mode -- the only mode this module implements), and keeps it
	  paired to its ground-side peer, before starting the transport
	  bridge itself. The ar8030 package no longer builds a kernel
	  module at all, so this package is now the sole provider of AR8030
	  kernel-side support.

	  Requires the ar8030 package's own
	  0008-session_socket-preserve-datagram-flag-on-open.patch (see
	  ar8030-transport's README "Required AR8030 SDK fix" -- without
	  it, chunks above ~690 bytes fail). Also expects waybeam to be
	  present and its frame-shm ring enabled, but that is not wired as
	  a hard Buildroot dependency here since waybeam can come from a
	  different image; enable it yourself if this device doesn't
	  already have it.

	  Installs /usr/bin/ar8030-transport-tx, /usr/bin/ar8030-linkctl,
	  artosyn_drv.ko, and /etc/init.d/S65ar8030-transport-tx.

comment "ar8030-transport-tx needs ar8030, a Linux kernel, and a toolchain w/ threads"
	depends on !BR2_PACKAGE_AR8030 || !BR2_LINUX_KERNEL || !BR2_TOOLCHAIN_HAS_THREADS
```

## package/ar8030/Config.in
```kconfig
config BR2_PACKAGE_AR8030
	bool "ar8030"
	depends on BR2_INSTALL_LIBSTDCPP
	depends on BR2_TOOLCHAIN_HAS_THREADS
	help
	  Artosyn AR8030 baseband host support — the vendor "yz_host_drv"
	  SDK's userspace RPC daemon + client library (userspace only; the
	  kernel driver is a separate concern, see below).

	  Always installed:
	  - ar8030d: the SDK "daemon". It owns the char device and serves
	    the RPC that applications talk to (TCP on 127.0.0.1 plus a unix
	    socket). Nothing else can reach the baseband while it is down,
	    so it must be started before any client.
	  - libar8030_client.so: the bb_* client API. Headers are installed
	    into <staging>/usr/include/ar8030.

	  Upstream calls these "daemon", "app", "ota" and "cmd_dbg"; they
	  are installed with an ar8030 prefix here so they can share
	  /usr/bin with the rest of the rootfs.

	  This package does not build a kernel module at all -- it used to
	  (the vendor SDK's own out-of-tree driver, USB+SDIO+DRV-mode in
	  one module, incrementally patched here to fix a series of real
	  bugs found over an extended investigation), but that driver is
	  gone in favor of a clean-room-rewritten replacement:
	  ar8030-transport's own kmod/artosyn_drv.c, built and installed by
	  the ar8030-transport-tx package instead. See that repo's
	  README.md ("Clean-room rewrite" section) for the full story of
	  why. Only SDIO-mode transport (daemon -i 1, /dev/artosyn_sdio) is
	  available as a result -- DRV-mode (-i 3, /dev/ar_mdev<N>) has no
	  kernel-side counterpart left to open.

	  The SDK is only published as source on a vendor Gitea instance
	  (no releases, no tags), so the package is pinned to a commit.

	  https://git.topxgun.com/czdu/yz_host_drv

comment "ar8030 needs a toolchain w/ C++, threads"
	depends on !BR2_INSTALL_LIBSTDCPP || !BR2_TOOLCHAIN_HAS_THREADS

if BR2_PACKAGE_AR8030

config BR2_PACKAGE_AR8030_FIRMWARE
	bool "install the demo baseband firmware"
	default y
	help
	  Installs the vendor's demo baseband image + config to
	  /lib/firmware/ar8030 (ar8030.img, ar8030.json), so the kernel
	  module (ar8030-transport-tx's own artosyn_drv.ko) can boot the
	  chip with fw_name=/cfg_name= module parameters.

	  ar8030.json is committed; ar8030.img is fetched fresh at build
	  time instead, by whatever script BR2_PACKAGE_AR8030_FIRMWARE_
	  FETCH_SCRIPT names (below) -- it's a proprietary vendor binary
	  this repo does not commit. Best-effort: no network or a broken
	  fetch just means ar8030.img isn't installed that build, not a
	  build failure (ar8030-transport-tx's own S65 init script already
	  omits fw_name= gracefully when it's absent). Sensor/camera
	  tuning, if this board needs any, is a *different* package's
	  concern (e.g. waybeam) -- not this one's.

	  Turn this off if the AR8030 on your board boots from its own
	  flash.

config BR2_PACKAGE_AR8030_FIRMWARE_FETCH_SCRIPT
	string "vendor firmware fetch script (path relative to the external tree)"
	depends on BR2_PACKAGE_AR8030_FIRMWARE
	help
	  Every AR8030-based board sources its demo baseband image from
	  its own vendor's stock firmware, in that vendor's own format --
	  this package deliberately carries none of that itself, so it
	  stays reusable across boards from different vendors. Set this in
	  your device's own defconfig to a script path relative to the
	  external tree root (the BR2_EXTERNAL variable, this build's
	  general/ directory), e.g. "scripts/fetch-vendor-firmware.py" for
	  a script living at your device's general/scripts/fetch-vendor-
	  firmware.py -- it gets copied there the same way general/
	  scripts/make-usrdata-image.sh does.

	  Called as: <script> <BINARIES_DIR> <output-dir>, before this
	  package builds. Must write ar8030.img into <output-dir> (nothing
	  else -- a sibling package handles any sensor tuning this board
	  also needs from the same vendor image), and must never fail the
	  build itself -- print a warning and leave <output-dir> empty on
	  any failure instead.

	  See devices/hi3516cv6xx_fpv_caddx-ascent-lite's defconfig +
	  general/scripts/fetch-vendor-firmware.py for a full example
	  (CADDX's "Ascent H Sky" OTA image on Google Drive). Left empty,
	  no fetch runs and ar8030.img doesn't get installed.

config BR2_PACKAGE_AR8030_FIRMWARE_FETCH_DEPENDENCY
	string "extra package this fetch script needs built first (optional)"
	depends on BR2_PACKAGE_AR8030_FIRMWARE
	help
	  Optional Buildroot package name, added to AR8030_DEPENDENCIES,
	  that BR2_PACKAGE_AR8030_FIRMWARE_FETCH_SCRIPT (above) needs
	  already built -- e.g. a device-owned package that does the
	  actual vendor download/extraction once and caches it, shared
	  with other packages that also need pieces of the same vendor
	  image (this device's own ascent-vendor-firmware, shared with
	  waybeam's sensor tuning, is the worked example). This is what
	  actually gets you "downloaded/extracted before this package
	  builds" with a real guarantee -- BR2_ROOTFS_PRE_BUILD_SCRIPT
	  looks like the obvious tool for that but is not wired into this
	  project's build (nothing make BOARD=... runs depends on it).

	  Leave empty if your fetch script is self-contained (does its own
	  fetching with no ordering requirement against another package).

config BR2_PACKAGE_AR8030_PAIR_TOOL
	bool "bb_pair binding tool"
	default y
	select BR2_PACKAGE_CJSON
	help
	  Installs bb_pair as /usr/bin/ar8030-pair: the vendor's
	  pair/bind utility. Talks to ar8030d over the local RPC socket,
	  so the daemon has to be running.

	  On a successful pair, also writes the peer's MAC into the
	  on-disk baseband config (see 0006-*.patch) so it survives the
	  next reboot's firmware push, and ar8030-transport-tx's own S65
	  init script spawns a background loop (see 0007-*.patch) that
	  keeps reconnecting to it at every boot -- so a paired unit no
	  longer needs to be re-paired by hand every time.

config BR2_PACKAGE_AR8030_USB_LOADER
	bool "USB rom-code firmware loader"
	default n
	help
	  Installs ar8030_usb_test_tool as /usr/bin/ar8030-usb-loader,
	  the userspace path for pushing a baseband image into an AR8030
	  sitting in USB rom-code mode (VID:PID 4152:8030), used together
	  with the SDK's mdev "autoload" hotplug flow.

	  Redundant when the kernel driver does the download itself, and
	  it statically links the SDK's bundled libusb, so it is off by
	  default.

config BR2_PACKAGE_AR8030_TOOLS
	bool "extra debug tools"
	default n
	help
	  Installs the SDK's demo and debug programs:
	    ar8030-cmd-dbg      interactive command console (cmd_dbg)
	    ar8030-ota          OTA image upgrade tool (ota)
	    ar8030-test         the generic API demo (app)
	    ar8030-netdev-demo  network-interface configuration demo

	  These are vendor test programs, not production tooling.
	  ar8030-netdev-demo in particular is dead weight on this board now:
	  it talks to /dev/ar_net<N>, a char device only the old combined
	  kernel driver's net_dev.c ever created (see BR2_PACKAGE_AR8030's
	  own help), and that driver is gone -- see BR2_PACKAGE_AR8030_TUNTAP
	  below for this board's actual way to get an IP-routable interface
	  over the RF link.

config BR2_PACKAGE_AR8030_LIFECYCLED
	bool "lifecycle supervisor daemon"
	default n
	select BR2_PACKAGE_CJSON
	help
	  Installs ar8030-lifecycled: a dedicated process that owns the
	  AR8030 chip's whole lifecycle instead of leaving it to a pile of
	  independent shell-script watchdogs -- pulses the chip's hardware
	  reset line at startup, subscribes to the daemon's own link-state/
	  pair-result events (with a permanent BB_GET_STATUS fallback poll
	  as a safety net), triggers this project's pairing dispatch only
	  if this unit has never been paired before, and follows real link
	  state transitions. See dev_helper/ar8030-lifecycled/main.c for
	  its full set of CLI flags (reset backend/GPIO, hook directory,
	  baseband config path, default tuning).

	  Deliberately a separate process from ar8030d, not a thread
	  inside it -- confirmed live that running this same logic as an
	  in-daemon pthread wedged the daemon itself under an SDIO
	  transport fault; a genuinely separate process talking to ar8030d
	  over loopback, exactly like ar8030-linkctl/ar8030-pair already
	  do, does not share that risk.

	  Does not yet do tuning persistence (bandwidth/channel surviving
	  a reconnect) or hook-script dispatch on state transitions (LED
	  control, ifup/ifdown, starting/stopping a transport binary) --
	  both deliberately deferred rather than rushed. A board wiring
	  this into its own boot sequence today still needs its own
	  shell-script layer for those two things; see
	  ar8030-transport-tx's own S65 init script for the air-side
	  worked example of what it does and does not yet replace.

config BR2_PACKAGE_AR8030_TUNTAP
	bool "TUN bridge over the RF link"
	default n
	help
	  Installs tuntap_bb as /usr/bin/ar8030-tun: bridges a normal Linux
	  TUN interface to a raw baseband socket (bb_socket_open/read/write
	  in libar8030_client, com/bb_api.h) opened over the RPC connection
	  to ar8030d -- unlike ar8030-netdev-demo (see BR2_PACKAGE_AR8030_TOOLS),
	  this only needs the daemon's RPC socket, not any kernel-side netdev
	  support, so it works fine on top of this board's SDIO-only
	  clean-room driver (ar8030-transport-tx's artosyn_drv.ko) with
	  nothing added to it. Gives an IP-routable interface over the RF
	  link once both ends run a matching bridge at the same slot/port --
	  see OpenIPC/sbc-groundstations' own BR2_PACKAGE_AR8030_TUNTAP,
	  which this option mirrors (same upstream tool, same two patches
	  below), for the ground-side half.

	  Needs CONFIG_TUN in the kernel (this device's own defconfig adds
	  a fragment for it -- see devices/hi3516cv6xx_fpv_caddx-ascent-lite/
	  br-ext-chip-hisilicon/board/hi3516cv6xx/fragments/tun.config).

	  Links a vendored copy of libtuntap (dev_helper/tuntap_bb/
	  third_package/libtuntap.tar) -- there is no standalone Buildroot
	  package for it to use instead; see AR8030_INSTALL_TUNTAP in
	  ar8030.mk for how its shared libs get shipped since this package's
	  own AR8030_INSTALL_TARGET_CMDS override skips CMake's install()
	  step. Costs some flash (ar8030-tun + libtuntap*.so*) that this
	  board otherwise deliberately avoids spending on network tooling
	  (see the device defconfig's own comment on why iptables/mosquitto/
	  wireguard are dropped) -- worth it here because, unlike those,
	  this is IP connectivity actually asked for, not carried by default.

endif
```

## package/artlynk-p1-vendor-firmware/Config.in
```kconfig
config BR2_PACKAGE_ARTLYNK_P1_VENDOR_FIRMWARE
	bool "artlynk-p1-vendor-firmware"
	help
	  Extracts the proprietary blobs the BetaFPV P1 SKY needs from
	  BetaFPV's stock P1 SKY OTA image into output/images/artlynk-p1/
	  and installs the codec/ISP ones:
	    /lib/firmware/cnm/wave521c_k3_codec_fw.bin   (wave5 codec)
	    /lib/firmware/artosyn/nt99235-tuning-preview-fpv.bin (ISP)
	    /lib/firmware/ar8030/bb_config_air.json      (P1 RF config)
	  The AR8030 baseband image and the generated p1_ascent_air.json
	  (P1 as AP, Ascent link settings) are installed by the ar8030
	  package, as ar8030.img and ar8030.json, through the device's
	  fetch script. The stock SPL/U-Boot/DDR
	  firmware are kept in output/images/artlynk-p1/ for USB boot.

	  Nothing is committed. The stock release the .mk pins is
	  cache/vendor-images/<release>.img (or ARTLYNK_P1_VENDOR_IMG);
	  without it, the device's scripts/fetch-vendor-img.sh downloads
	  BetaFPV's copy from Google Drive (file id in the .mk). See
	  extract.py for host prerequisites. Missing pieces are skipped
	  with a warning, never a build failure.
```
